/************************************/
/*  어셈블리어 링커 스크립트 파일   */
/************************************/
SECTIONS
{
  . = 0x00000000;       /* 프로그램 영역 시작 번지*/
  .text : { *(.text) }
  . = 0x40000000;       /* 데이터 영역 시작 번지*/
  .data : { *(.data) }
}

